// Pantalla y táctil de la Waveshare ESP32-P4 4C (ver board.h).
#ifdef BOARD_P4
#include <Arduino.h>
#include <driver/ppa.h>
#include <esp_cache.h>
#include <esp_lcd_panel_ops.h>
#include "board.h"

// Secuencia del JD9365 para el panel de 720x720 (BSP waveshare/esp32_p4_wifi6_touch_lcd_xc).
// Formato de LovyanGFX: longitud (comando + datos), comando, datos; un 0 cierra la lista.
const uint8_t *Panel_JD9365_4C::getInitParams(size_t listno) const {
    static constexpr uint8_t list0[] = {
            2, 0xE0, 0x00, 2, 0xE1, 0x93, 2, 0xE2, 0x65, 2, 0xE3, 0xF8, 2, 0x80, 0x01, 2, 0xE0, 0x01,
            2, 0x00, 0x00, 2, 0x01, 0x41, 2, 0x03, 0x10, 2, 0x04, 0x44, 2, 0x17, 0x00, 2, 0x18, 0xD0,
            2, 0x19, 0x00, 2, 0x1A, 0x00, 2, 0x1B, 0xD0, 2, 0x1C, 0x00, 2, 0x24, 0xFE, 2, 0x37, 0x09,
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            0,
    };
    static constexpr uint8_t list1[] = {1, 0x29, 0};
    // 0x55 = 0: CABC (brillo adaptativo al contenido) apagado. Encendido, el panel reajusta el brillo a
    // escalones cada vez que cambia la imagen (el avatar se anima): el fondo «palpitaba»
    static constexpr uint8_t list2[] = {2, 0x35, 0x00, 2, 0x55, 0x00, 0};
    return listno == 0 ? list0 : listno == 1 ? list1 : listno == 2 ? list2 : nullptr;
}

static ppa_client_handle_t ppa = nullptr;
static void *fb = nullptr;

bool LGFX::init() {
    pinMode(PIN_LCD_RST, OUTPUT);
    digitalWrite(PIN_LCD_RST, LOW);
    delay(10);
    digitalWrite(PIN_LCD_RST, HIGH);
    delay(120);
    lgfx::i2c::init(I2C_PORT, PIN_I2C_SDA, PIN_I2C_SCL);
    bool ok = LGFX_Device::init();
    // dos framebuffers con cambio en cada cuadro parpadeaba en blanco y negro (27 oct): uno solo
    fb = _panel.config_detail().buffer;
    if (fb) {
        memset(fb, 0, PHYS * PHYS * 2);
        esp_cache_msync(fb, PHYS * PHYS * 2, ESP_CACHE_MSYNC_FLAG_DIR_C2M);
    }
    Serial.printf("pantalla: %s · framebuffer %p\n", ok ? "OK" : "FALLA", fb);
    ppa_client_config_t pc = {};
    pc.oper_type = PPA_OPERATION_SRM;
    pc.max_pending_trans_num = 1;
    if (ppa_register_client(&pc, &ppa) != ESP_OK) { Serial.println("ppa: no se pudo registrar"); ppa = nullptr; }
    auto r = lgfx::i2c::transactionWrite(I2C_PORT, 0x5D, nullptr, 0, 100000);
    Serial.printf("táctil: GT911 %s\n", r.has_value() ? "responde" : "no responde");
    return ok && fb && ppa;
}

bool LGFX::getTouch(lgfx::touch_point_t *tp) {
    return LGFX_Device::getTouch(tp, 1) > 0;
}

void LGFX::flush(LGFX_Sprite &s, int x, int y, int w, int h) {
    if (!fb || !ppa) return;
    int x1 = min(PHYS, x + w), y1 = min(PHYS, y + h);
    x = max(0, x);
    y = max(0, y);
    if (x1 <= x || y1 <= y) return;
    uint8_t *src = (uint8_t *)s.getBuffer();
    esp_cache_msync(src + y * PHYS * 2, (y1 - y) * PHYS * 2, ESP_CACHE_MSYNC_FLAG_DIR_C2M | ESP_CACHE_MSYNC_FLAG_UNALIGNED);
    ppa_srm_oper_config_t op = {};
    op.in.buffer = src;
    op.in.pic_w = PHYS;
    op.in.pic_h = PHYS;
    op.in.block_w = x1 - x;
    op.in.block_h = y1 - y;
    op.in.block_offset_x = x;
    op.in.block_offset_y = y;
    op.in.srm_cm = PPA_SRM_COLOR_MODE_RGB565;
    op.out.buffer = fb;
    op.out.buffer_size = PHYS * PHYS * 2;
    op.out.pic_w = PHYS;
    op.out.pic_h = PHYS;
    op.out.block_offset_x = x;
    op.out.block_offset_y = y;
    op.out.srm_cm = PPA_SRM_COLOR_MODE_RGB565;
    op.rotation_angle = PPA_SRM_ROTATION_ANGLE_0;
    op.scale_x = op.scale_y = 1.0f;
    op.byte_swap = true;            // el sprite es RGB565 big-endian; el DPI lo quiere nativo
    op.mode = PPA_TRANS_MODE_BLOCKING;
    ppa_do_scale_rotate_mirror(ppa, &op);
}

// entero, por franjas con un respiro entre ellas: de un golpe el DPI se queda sin PSRAM
void LGFX::present(LGFX_Sprite &s) {
    for (int y = 0; y < PHYS; y += 48) {
        flush(s, 0, y, PHYS, 48);
        delayMicroseconds(300);
    }
}
#endif
